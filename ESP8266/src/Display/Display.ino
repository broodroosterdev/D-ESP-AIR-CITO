/************************* Including Libraries *********************************/
//Libraries nodig voor de sketch
#include "bsec.h"
#include <ESP8266WiFi.h>
#include <Adafruit_MQTT.h>
#include <Adafruit_MQTT_Client.h>
#include <DNSServer.h>
#include <ESP8266WebServer.h>
#include <WiFiManager.h>
#include <Wire.h>
#include <Adafruit_GFX.h>
#include <Adafruit_SSD1306.h>
#include "LED.h"
/************************* Defining Variables **********************************/
//Globale variabelen
#define SCREEN_WIDTH 128 // OLED display width, in pixels
#define SCREEN_HEIGHT 32 // OLED display height, in pixels
#define temperature_feed "/sensors/temperature/1"
#define humidity_feed "/sensors/humidity/1"
#define pressure_feed "/sensors/pressure/1"
#define iaq_feed "/sensors/iaq/1"
#define accuracy_feed "/sensors/accuracy/1"
#define uptime_feed "/sensors/uptime/1"
#define memory_feed "/sensors/memory/1"
#define rssi_feed "/sensors/rssi/1"
#define restart_feed "/sensors/restart/1"
#define led_feed "/sensors/led/1"
#define AIO_SERVER      "pwsvps.ddns.net"
#define AIO_SERVERPORT  1883                  // 8883 for MQTTS
#define AIO_USERNAME    "mqttusername"
#define AIO_KEY         "mqttpassword"
/************************* Defining helper functions *********************************/
//Functies voor het checken van werking van Sensor
void checkIaqSensorStatus(void);
void errLeds(void);
/************************* Creating Objects for hardware components *********************************/
//Maakt objecten voor alle hardware
WiFiClientSecure client;
Bsec iaqSensor;
LED led = LED(12,5);
Adafruit_SSD1306 _display(SCREEN_WIDTH, SCREEN_HEIGHT, &Wire);
/************************* Defining global variables *********************************/
//Globale variabelen
int _isloading = 0;
int _sliding = 0;
int slide = 0;
String output;
volatile int toggle;
String unit;
/************************* Defining MQTT server and topics *********************************/
//Maakt MQTT objecten
Adafruit_MQTT_Client mqtt(&client, AIO_SERVER, AIO_SERVERPORT);
Adafruit_MQTT_Publish temperature_topic = Adafruit_MQTT_Publish(&mqtt, temperature_feed);
Adafruit_MQTT_Publish pressure_topic = Adafruit_MQTT_Publish(&mqtt, pressure_feed);
Adafruit_MQTT_Publish humidity_topic = Adafruit_MQTT_Publish(&mqtt, humidity_feed);
Adafruit_MQTT_Publish iaq_topic = Adafruit_MQTT_Publish(&mqtt, iaq_feed);
Adafruit_MQTT_Publish accuracy_topic = Adafruit_MQTT_Publish(&mqtt, accuracy_feed);
Adafruit_MQTT_Publish uptime_topic = Adafruit_MQTT_Publish(&mqtt, uptime_feed);
Adafruit_MQTT_Publish memory_topic = Adafruit_MQTT_Publish(&mqtt, memory_feed);
Adafruit_MQTT_Publish rssi_topic = Adafruit_MQTT_Publish(&mqtt, rssi_feed);
Adafruit_MQTT_Subscribe restart_topic = Adafruit_MQTT_Subscribe(&mqtt, restart_feed);
Adafruit_MQTT_Subscribe led_topic = Adafruit_MQTT_Subscribe(&mqtt, led_feed);
/************************* Defining bitmap of icons *********************************/
//Bitmap arrays voor alle iconen
const unsigned char PROGMEM _warning[] = {
  0x0,0x1,0x80,0x0,
  0x0,0x1,0x80,0x0,
  0x0,0x3,0xc0,0x0,
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  0x7f,0xff,0xff,0xfe
};
const unsigned char PROGMEM _loading1[] = {
  0x0,0x1,0x80,0x0,
  0x0,0x1,0x80,0x0,
  0x0,0x1,0x80,0x0,
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  0x0,0x1,0x80,0x0
};
  const unsigned char PROGMEM _loading[] = {
  0x0,0x0,0x0,0x0,
  0x0,0x18,0x18,0x0,
  0x0,0x38,0x1c,0x0,
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  0x0,0x0,0x0,0x0
};
const unsigned char PROGMEM _humidity[]  = {
  0x0,0x0,0x0,0x0,
  0x0,0x0,0x0,0x0,
  0x0,0x0,0x0,0x0,
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  0x0,0x0,0x0,0x0
};  
  const unsigned char PROGMEM _temperature[] = {
  0x0,0x1,0x80,0x0,
  0x0,0x3,0xc0,0x0,
  0x0,0x3,0xc0,0x0,
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  0x0,0x3,0xc0,0x0
};
  const unsigned char PROGMEM _gas[] = {
  0x0,0x0,0x0,0x0,
  0x0,0x0,0x0,0x0,
  0x0,0x0,0x0,0x0,
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  0x0,0x0,0x0,0x0
};
/************************* Setup Function *********************************/
//Functie die draait wanneer ESP opstart
void setup(void)
{
  Serial.begin(115200); //Begint seriële poort
  if(!_display.begin(SSD1306_SWITCHCAPVCC, 0x3C)) { // Address 0x3C for 128x32
    for(;;); // Don't proceed, loop forever
  }
  _display.clearDisplay(); //
  _display.display();
  mqtt.subscribe(&restart_topic);
  mqtt.subscribe(&led_topic);
  StartLoading();
  unit = "MQTT";
  iaqSensor.begin(BME680_I2C_ADDR_PRIMARY, Wire);
  unit = "BSEC";
  loading_handler();
  delay(500);
  led.Begin();
  unit = "LED";
  loading_handler();
  delay(500);
  WiFiManager wifiManager;
  unit = "WiFi";
  loading_handler();
  delay(500);
  wifiManager.setConnectTimeout(60);
  wifiManager.autoConnect();
  unit = "Connected";
  loading_handler();
  delay(500);
  output = "\nBSEC library version " + String(iaqSensor.version.major) + "." + String(iaqSensor.version.minor) + "." + String(iaqSensor.version.major_bugfix) + "." + String(iaqSensor.version.minor_bugfix);
  Serial.println(output);
  checkIaqSensorStatus();
  unit = "Sensor";
  loading_handler();
  delay(500);

  bsec_virtual_sensor_t sensorList[10] = {
    BSEC_OUTPUT_RAW_TEMPERATURE,
    BSEC_OUTPUT_RAW_PRESSURE,
    BSEC_OUTPUT_RAW_HUMIDITY,
    BSEC_OUTPUT_RAW_GAS,
    BSEC_OUTPUT_IAQ,
    BSEC_OUTPUT_STATIC_IAQ,
    BSEC_OUTPUT_CO2_EQUIVALENT,
    BSEC_OUTPUT_BREATH_VOC_EQUIVALENT,
    BSEC_OUTPUT_SENSOR_HEAT_COMPENSATED_TEMPERATURE,
    BSEC_OUTPUT_SENSOR_HEAT_COMPENSATED_HUMIDITY,
  };

  iaqSensor.updateSubscription(sensorList, 10, BSEC_SAMPLE_RATE_LP);
  loading_handler();
  MQTT_connect();
  unit = "MQTT";
  loading_handler();
  delay(500);
  checkIaqSensorStatus();
  unit = "Ready!";
  loading_handler();
  delay(500);
  StopLoading();
  led.ShowRainbow();
  
}
/************************* loop Function *********************************/
void loop(void)
{
  unsigned long time_trigger = millis();
  if (iaqSensor.run()) { // If new data is available
    temperature_topic.publish(iaqSensor.temperature);
    humidity_topic.publish(iaqSensor.humidity);
    pressure_topic.publish(iaqSensor.pressure);
    accuracy_topic.publish(iaqSensor.iaqAccuracy);
    iaq_topic.publish(iaqSensor.iaqEstimate);
    memory_topic.publish(ESP.getFreeHeap());
    rssi_topic.publish(WiFi.RSSI());
    unsigned int uptime = millis()/1000;
    uptime_topic.publish(uptime);
    led.ShowIAQ(iaqSensor.iaqEstimate);
    StartSlides();
    sliding_handler();
  } else {
    checkIaqSensorStatus();
    MQTT_connect();
    Adafruit_MQTT_Subscribe *subscription;
  while ((subscription = mqtt.readSubscription(1000))) {
    if (subscription == &restart_topic) {
      Serial.println((char*)restart_topic.lastread);
      Serial.println("Restarting.....");
      ESP.restart();
    }
    if (subscription == &led_topic) {
    uint8_t led_status = atoi((char*)led_topic.lastread);
    uint8_t led_on = 1;
    if(led_status == led_on){
      led.EnableLED(iaqSensor);
    }else{
      led.DisableLED();
    }
  }
  }
  

  }

}
void loading_handler (void){
  if(_isloading == 1){
    toggle = (toggle == 1) ? 0 : 1;
  if(toggle == 1){
        _display.clearDisplay();
        _display.drawBitmap(
        (_display.width()  - 32 ) / 2 + 32,
        (_display.height() - 32) / 2,
        _loading, 32, 32, 1);
        float data;
        _display.display();
        ShowData(data);
  }else{
        _display.clearDisplay();
        _display.drawBitmap(
        (_display.width()  + 32 ) / 2 + 32,
        (_display.height() + 32) / 2,
        _loading1, 32, 32, 1);
        float data;
        _display.display();
        ShowData(data);
    }
  }
}
void sliding_handler (void){
  if(_sliding == 1){
        if(slide == 0){
            ShowIAQ(iaqSensor.iaqEstimate);
            slide++;                
        }else if(slide == 1){
          ShowTemperature(iaqSensor.temperature);
          slide++;
        }else if(slide == 2){
          ShowHumidity(iaqSensor.humidity);
          slide = 0;
        }
       
  }  
}
void MQTT_connect() {
  int8_t ret;
  // Stop if already connected.
  if (mqtt.connected()) {
    return;
  }
  Serial.print("Connecting to MQTT... ");
  uint8_t retries = 5;
  while ((ret = mqtt.connect()) != 0) { // connect will return 0 for connected
    Serial.println(mqtt.connectErrorString(ret));
    Serial.println("Retrying MQTT connection in 1 second...");
    mqtt.disconnect();
    delay(500);  // wait a half second
    retries--;
    if (retries == 0) {
    }
  }
  
  Serial.println("MQTT Connected!");
}

void ShowIAQ(float IAQ){
    _display.clearDisplay();
    _display.drawBitmap(
        (_display.width()  - 32 ) / 2 + 32,
        (_display.height() - 32) / 2,
        _gas, 32, 32, 1);
    unit = "";
    ShowData(IAQ);
    //types();
    _display.display();
}

void ShowHumidity(float Humidity){
    _display.clearDisplay();
    _display.drawBitmap(
        (_display.width()  - 32 ) / 2 + 32,
        (_display.height() - 32) / 2,
        _humidity, 32, 32, 1);
    unit = "%";
    ShowData(Humidity);

    _display.display();
    
}

void ShowTemperature(float Temperature){
    _display.clearDisplay();
    _display.drawBitmap(
        (_display.width()  - 32 ) / 2 + 32,
        (_display.height() - 32) / 2,
        _temperature, 32, 32, 1);
    unit = (char)247;
    unit.concat("C");
    ShowData(Temperature);
    _display.display();
}
void ShowData(float data) {
    String Text;
    if(!(data == 0.00)){
      Text = String(data);
      Text.concat(unit);
    }else{
      Text = unit;
    }
    
    _display.setTextSize(2); // Draw 2X-scale text
    _display.setTextColor(WHITE);
    _display.setCursor(0, 0);
    _display.println(Text);
    _display.display();      // Show initial text
}

void StopSlides() {
    _sliding = 0;
    _display.clearDisplay();
}

void StartSlides() {
    _sliding = 1;
}

void StartLoading() {
    _isloading = 1;
}

void StopLoading() {
    _isloading = 0;
    _display.clearDisplay();
}

void checkIaqSensorStatus(void)
{
  if (iaqSensor.status != BSEC_OK) {
    if (iaqSensor.status < BSEC_OK) {
      output = "BSEC error code : " + String(iaqSensor.status);
      Serial.println(output);
      unit = "BSEC: " + String(iaqSensor.status);
      for (;;)
        
        errLeds(); /* Halt in case of failure */
        
    } else {
      output = "BSEC warning code : " + String(iaqSensor.status);
      Serial.println(output);
    }
  }

  if (iaqSensor.bme680Status != BME680_OK) {
    if (iaqSensor.bme680Status < BME680_OK) {
      output = "BME680 error code : " + String(iaqSensor.bme680Status);
      Serial.println(output);
      unit = "BME: " + String(iaqSensor.bme680Status);
      for (;;)
        
        errLeds(); /* Halt in case of failure */
        
    } else {
      output = "BME680 warning code : " + String(iaqSensor.bme680Status);
      Serial.println(output);
    }
  }
}

void errLeds(void)
{
  StopSlides();
  pinMode(LED_BUILTIN, OUTPUT);
  digitalWrite(LED_BUILTIN, HIGH);
  delay(100);
  digitalWrite(LED_BUILTIN, LOW);
  delay(100);
  _display.clearDisplay();
    _display.drawBitmap(
        (_display.width()  - 32 ) / 2 + 32,
        (_display.height() - 32) / 2,
        _warning, 32, 32, 1);
        float data;
    ShowData(data);
    _display.display();
}